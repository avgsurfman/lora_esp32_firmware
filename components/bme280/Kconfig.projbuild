## components/bme280/Kconfig.projbuild
```kconfig
menu "BME280 configuration"
    config BME280
        bool "Enable the module"
	default y
    config BME280_I2C_ADDRESS
        hex "I2C address"
	depends on BME280
        default (0x76)
        help
            I2C address of the BME280 sensor.
endmenu
```

## components/bmi160/Kconfig.projbuild
```kconfig
menu "BMI160 Configuration"
	config BMI160
		bool "Enable Bosch BMI160 Accelerometer"
		default y
		help
			Enable the BMI160 chip. Disable this if you don't have it.
	menu "SDA Pin"
		config BMI160_I2C_SCL
			int "SCL GPIO Num"
			default 0
			depends on BMI160
			help
				(NOT IMPLEMENTED) GPIO number for I2C slave clock line.
        	config BMI160_I2C_SDA
            		int "SDA GPIO Num"
            		default 1
			depends on BMI160
            		help
                		(NOT IMPLEMENTED) GPIO number for I2C slave data line.
		endmenu
	menu "Master Frequency"
		config BMI160_I2C_MASTER_FREQ
			int "Master frequency"
			default 100000
			depends on BMI160
			help
				I2C Speed of the Master device.
	endmenu

	menu "I2C Adress"
		config BMI160_SLAVE_ALT_ADDR
			bool "Use the alternative 0x69 adress instead of the default 0x68  address."
			depends on BMI160
			help 
				Note: Changing the adress requires to default (0x68) requires connection to the ground.
	endmenu

endmenu
```

## components/gauge/Kconfig.projbuild
```kconfig
menu "BQ27441 Fuel Gauge Configuration"
    config BQ27441
        bool "Enable the module"
	default y

    config BQ27441_I2C_ADDRESS
        hex "I2C address"
	depends on BQ27441
        default 0x55
        help
            I2C address of the BQ27441 fuel gauge.

    config BQ27441_DESIGN_CAPACITY
        int "Design Capacity (mAh)"
	depends on BQ27441
        default 3400
        help
            The design capacity of the battery in mAh.

    config BQ27441_TERMINATE_VOLTAGE
        int "Terminate Voltage (mV)"
	depends on BQ27441
        default 3200
        help
            The terminate voltage of the battery in mV.

endmenu
```
